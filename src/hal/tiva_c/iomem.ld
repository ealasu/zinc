PROVIDE(isr_gpio_port_a = isr_hardfault);                      
PROVIDE(isr_gpio_port_b = isr_hardfault);                      
PROVIDE(isr_gpio_port_d = isr_hardfault);                      
PROVIDE(isr_gpio_port_e = isr_hardfault);                      
PROVIDE(isr_uart0 = isr_hardfault);                      
PROVIDE(isr_uart1 = isr_hardfault);                      
PROVIDE(isr_ssi0 = isr_hardfault);                      
PROVIDE(isr_i2c0 = isr_hardfault);                      
PROVIDE(isr_pwm_fault = isr_hardfault);                      
PROVIDE(isr_pwm_generator_0 = isr_hardfault);                      
PROVIDE(isr_pwm_generator_1 = isr_hardfault);                      
PROVIDE(isr_pwm_generator_2 = isr_hardfault);                      
PROVIDE(isr_quadrature_encoder_0 = isr_hardfault);                      
PROVIDE(isr_adc_sequence_0 = isr_hardfault);                      
PROVIDE(isr_adc_sequence_1 = isr_hardfault);                      
PROVIDE(isr_adc_sequence_2 = isr_hardfault);                      
PROVIDE(isr_adc_sequence_3 = isr_hardfault);                      
PROVIDE(isr_watchdog_timer = isr_hardfault);                      
PROVIDE(isr_timer_0_a = isr_hardfault);                      
PROVIDE(isr_timer_0_b = isr_hardfault);                      
PROVIDE(isr_timer_1_a = isr_hardfault);                      
PROVIDE(isr_timer_1_b = isr_hardfault);                      
PROVIDE(isr_timer_2_a = isr_hardfault);                      
PROVIDE(isr_timer_2_b = isr_hardfault);                      
PROVIDE(isr_analog_comparator_0 = isr_hardfault);                      
PROVIDE(isr_analog_comparator_1 = isr_hardfault);                      
PROVIDE(isr_analog_comparator_2 = isr_hardfault);                      
PROVIDE(isr_system_control = isr_hardfault);                      
PROVIDE(isr_flash_control = isr_hardfault);                      
PROVIDE(isr_gpio_port_f = isr_hardfault);                      
PROVIDE(isr_gpio_port_g = isr_hardfault);                      
PROVIDE(isr_gpio_port_h = isr_hardfault);                      
PROVIDE(isr_uart2 = isr_hardfault);                      
PROVIDE(isr_ssi1 = isr_hardfault);                      
PROVIDE(isr_timer_3_a = isr_hardfault);                      
PROVIDE(isr_timer_3_b = isr_hardfault);                      
PROVIDE(isr_i2c1 = isr_hardfault);                      
PROVIDE(isr_quadrature_encoder_1 = isr_hardfault);                      
PROVIDE(isr_can0 = isr_hardfault);                      
PROVIDE(isr_can1 = isr_hardfault);                      
PROVIDE(isr_hibernate = isr_hardfault);                      
PROVIDE(isr_usb0 = isr_hardfault);                      
PROVIDE(isr_pwm_generator_3 = isr_hardfault);                      
PROVIDE(isr_udma_software_transfer = isr_hardfault);                      
PROVIDE(isr_udma_error = isr_hardfault);                      
PROVIDE(isr_adc1_sequence_0 = isr_hardfault);                      
PROVIDE(isr_adc1_sequence_1 = isr_hardfault);                      
PROVIDE(isr_adc1_sequence_2 = isr_hardfault);                      
PROVIDE(isr_adc1_sequence_3 = isr_hardfault);                      
PROVIDE(isr_gpio_port_j = isr_hardfault);                      
PROVIDE(isr_gpio_port_k = isr_hardfault);                      
PROVIDE(isr_gpio_port_l = isr_hardfault);                      
PROVIDE(isr_ssi2 = isr_hardfault);                      
PROVIDE(isr_ssi3 = isr_hardfault);                      
PROVIDE(isr_uart3 = isr_hardfault);                      
PROVIDE(isr_uart4 = isr_hardfault);                      
PROVIDE(isr_uart5 = isr_hardfault);                      
PROVIDE(isr_uart6 = isr_hardfault);                      
PROVIDE(isr_uart7 = isr_hardfault);                      
PROVIDE(isr_i2c2 = isr_hardfault);                      
PROVIDE(isr_i2c3 = isr_hardfault);                      
PROVIDE(isr_timer_4_a = isr_hardfault);                      
PROVIDE(isr_timer_4_b = isr_hardfault);                      
PROVIDE(isr_timer_5_a = isr_hardfault);                      
PROVIDE(isr_timer_5_b = isr_hardfault);                      
PROVIDE(isr_wide_timer_0_a = isr_hardfault);                      
PROVIDE(isr_wide_timer_0_b = isr_hardfault);                      
PROVIDE(isr_wide_timer_1_a = isr_hardfault);                      
PROVIDE(isr_wide_timer_1_b = isr_hardfault);                      
PROVIDE(isr_wide_timer_2_a = isr_hardfault);                      
PROVIDE(isr_wide_timer_2_b = isr_hardfault);                      
PROVIDE(isr_wide_timer_3_a = isr_hardfault);                      
PROVIDE(isr_wide_timer_3_b = isr_hardfault);                      
PROVIDE(isr_wide_timer_4_a = isr_hardfault);                      
PROVIDE(isr_wide_timer_4_b = isr_hardfault);                      
PROVIDE(isr_wide_timer_5_a = isr_hardfault);                      
PROVIDE(isr_wide_timer_5_b = isr_hardfault);                      
PROVIDE(isr_fpu = isr_hardfault);                      
PROVIDE(isr_i2c4 = isr_hardfault);                      
PROVIDE(isr_i2c5 = isr_hardfault);                      
PROVIDE(isr_gpio_port_m = isr_hardfault);                      
PROVIDE(isr_gpio_port_n = isr_hardfault);                      
PROVIDE(isr_quadrature_encoder_2 = isr_hardfault);                      
PROVIDE(isr_gpio_port_p0 = isr_hardfault);                      
PROVIDE(isr_gpio_port_p1 = isr_hardfault);                      
PROVIDE(isr_gpio_port_p2 = isr_hardfault);                      
PROVIDE(isr_gpio_port_p3 = isr_hardfault);                      
PROVIDE(isr_gpio_port_p4 = isr_hardfault);                      
PROVIDE(isr_gpio_port_p5 = isr_hardfault);                      
PROVIDE(isr_gpio_port_p6 = isr_hardfault);                      
PROVIDE(isr_gpio_port_p7 = isr_hardfault);                      
PROVIDE(isr_gpio_port_q0 = isr_hardfault);                      
PROVIDE(isr_gpio_port_q1 = isr_hardfault);                      
PROVIDE(isr_gpio_port_q2 = isr_hardfault);                      
PROVIDE(isr_gpio_port_q3 = isr_hardfault);                      
PROVIDE(isr_gpio_port_q4 = isr_hardfault);                      
PROVIDE(isr_gpio_port_q5 = isr_hardfault);                      
PROVIDE(isr_gpio_port_q6 = isr_hardfault);                      
PROVIDE(isr_gpio_port_q7 = isr_hardfault);                      
PROVIDE(isr_gpio_port_r = isr_hardfault);                      
PROVIDE(isr_gpio_port_s = isr_hardfault);                      
PROVIDE(isr_pwm_1_generator_0 = isr_hardfault);                      
PROVIDE(isr_pwm_1_generator_1 = isr_hardfault);                      
PROVIDE(isr_pwm_1_generator_2 = isr_hardfault);                      
PROVIDE(isr_pwm_1_generator_3 = isr_hardfault);                      
PROVIDE(isr_pwm_1_fault = isr_hardfault);                      
